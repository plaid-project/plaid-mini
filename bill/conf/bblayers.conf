## bill/conf/bblayers.conf
```bitbake
POKY_BBLAYERS_CONF_VERSION = "2"

BBPATH = "${TOPDIR}"
BBFILES ?= ""

BBLAYERS ?= " \
  /build/poky/meta \
  /build/poky/meta-poky \
  /build/poky/meta-yocto-bsp \
  "
```

## bill/conf/local.conf
```bitbake
MACHINE ??= "qemux86-64"
DISTRO ?= "poky"
PACKAGE_CLASSES ?= "package_ipk"

IMAGE_INSTALL_append = " python3 python3-modules bash"

EXTRA_IMAGE_FEATURES ?= "debug-tweaks"

DL_DIR ?= "/yocto/downloads"
SSTATE_DIR ?= "/yocto/sstate-cache"

BB_NUMBER_THREADS ?= "${@oe.utils.cpu_count()}"
PARALLEL_MAKE ?= "-j ${@oe.utils.cpu_count()}"
```
